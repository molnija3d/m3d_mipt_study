/*
Упаковать 0 и 1
Написать функцию, которая сжимает серии массива, состоящего из единиц и нулей по следующему принципу: н
апример, массив [0,0,0,0,1,1,1,1,1,1,1,0,0,1,1,1,1] преобразуется в [4,7,2,4]
(т.к. начинается с нуля, то сразу записывается количество элементов первой серии);
а массив [1,1,1,0,0,0,0,0,0,0] преобразуется в [0,3,7] (т.к. первая серия - это единицы, то первый элемент преобразованного массива 0).
Необходимо реализовать только одну функцию, всю программу загружать не надо.
Прототип функции: int compression(int a[], int b[], int N)
Input format
Функция принимает исходный массив a[] и сжимает в массив b[], N - число элементов в массиве a[].
Output format
Функция возвращает число элементов сжатого массива b[]
*/

int compression(int a[], int b[], int N)
{
    int cnt=0,j=0,i=0;

    if(a[0])
    {
        while (i<N && a[i]==a[i+1])
            i++;

        b[j++] = 0;
        b[j++] = i+1;
        i++;
    }

    if(i+1 < N)
    {
        while((++i)<N)
        {
            if(a[i-1] == a[i])
                cnt++;
            else
            {
                b[j++]=cnt+1;
                cnt = 0;
            }
        }
        b[j++]=cnt+1;
    }
    return j;
}
