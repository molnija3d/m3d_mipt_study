/*
Задача 5-4-Двоичные нули
Для заданных натуральных чисел N и K требуется вычислить количество чисел от 1 до N, имеющих в двоичной записи ровно K нулей. Например, если N=8 и K=1, то мы можем записать все числа от 1 до 8 в двоичной системе счисления: 1, 10, 11, 100, 101, 110, 111 и 1000. Откуда видно, что только числа 10, 101 и 110 имеют ровно один ноль в записи, т.е. правильный ответ – 3.
Формат ввода:
На вход поступают два натуральных числа через пробел N и K, не превышающих 20001.
Формат вывода:
Нужно вывести одно целое число — количество чисел от 1 до N с K нулями в двоичном представлении.
*/
#include <stdio.h>
#include <inttypes.h>
int32_t get_zero_cnt(int32_t n, int32_t k);
int32_t cnt_zero(int32_t n);

int32_t main() {
    int32_t n = 0, k = 0;
    scanf("%"SCNd32" %"SCNd32, &n, &k);
    printf("%"PRId32, get_zero_cnt(n, k));
    return 0;
}

int32_t cnt_zero(int32_t n) {
    int32_t cnt = 0;
    while (n > 0) {
        if(!(n & 0x1)) {
            cnt++;
        }
        n >>= 1;
    }
    return cnt;
}

int32_t get_zero_cnt(int32_t n, int32_t k) {
    int32_t cnt = 0, tmp = 0;
    for(int32_t i = 2; i <= n; i++)
    {
        tmp = cnt_zero(i);
        if(tmp == k) {
            cnt++;
        }

    }
    return cnt;
}
