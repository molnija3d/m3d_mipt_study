#include <GyverHTU21D.h>
#include <APDS9930.h>
//задаем адрес второй Arduino UNO
#define dev_id 1
GyverHTU21D htu;
APDS9930 apds = APDS9930();

//определяем новый тип данных - структура для передачи показаний датчиков
typedef struct sensor_data_t {
  int32_t time;
  float light;  
  float hum;
  float temp;
  byte crc8;
};

const int data_size = sizeof(sensor_data_t); //определяем размер структуры

//для удобного доступа к структуре по байтам создаем новый тип данных через объедниение
typedef union data_packet_t { 
  sensor_data_t data;
  byte byte_a[data_size];
};

//объявляем структуру
data_packet_t sensors;

//переменные для отсчета времени
uint32_t msr_time = 0;
uint32_t send_time = 0;
uint32_t cur_time = 0;

byte CRC8(const byte *data, byte len);
void scan_devices();

void setup() {
  Serial.begin(9600);
  //инициализация HTU21D
  if (!htu.begin()) {
    Serial.println(F("HTU21D error"));
  }
  
  //инициализация APDS-9930
  if (!apds.init()) {
    Serial.println(F("APDS ERROR!"));
  }  // Иначе, выводим сообщение об ошибке инициализации датчика

  if (!apds.enableLightSensor(false)) {
    Serial.println(F("Start light sensor ERROR!"));
  }  // Иначе, выводим сообщение об ошибке запуска режима определения освещённости
  htu.readTick();

  scan_devices();  //cканируем устройства
}


void loop() {
  cur_time = millis();
  //считываем показания датчиков раз в 500мс
  if (cur_time - msr_time > 500) {
    msr_time = cur_time;
    // функция опрашивает датчик
    if (htu.readTick()) {
      sensors.data.hum = htu.getHumidity();
      sensors.data.temp = htu.getTemperature();
    }
    if (!apds.readAmbientLightLux(sensors.data.light)) {
      Serial.println(F("Read light ERROR!"));
    }
  }

  cur_time = millis();
  //осуществляем передачу данных 1 раз в 1000мс
  if (cur_time - send_time > 1000) {
    send_time = cur_time;

    Wire.beginTransmission(dev_id);
    /* альтернативный вариант передачи через массив
    for (uint8_t i = 0; i < data_size; i++) {
      Wire.write(sensors.byte_a[i]);
    }
    */
    Wire.write(sensors.byte_a, data_size);
    
    int err = Wire.endTransmission();
    if (err) {
      Serial.println((String)err + F(" ERROR SEND FAILED"));
    }
  }
}

void scan_devices() {
  byte error, address;
  int nDevices;
  Serial.println(F("\nScanning I2C:"));
  nDevices = 0;
  //всего на шине I2C может быть до 127 устройтсв
  for (address = 1; address < 127; address++) {
    Wire.beginTransmission(address);
    error = Wire.endTransmission();
    switch (error) {

      case 0:
        Serial.print(F("I2C device found at address 0x"));
        if (address < 16)
          Serial.print(F("0"));
        Serial.println(address, HEX);
        nDevices++;
        break;

      case 4:
        Serial.print(F("Unknown error at address 0x"));
        if (address < 16)
          Serial.print(F("0"));
        Serial.println(address, HEX);
        break;
    }
  }
  if (nDevices == 0)
    Serial.println(F("No I2C devices found"));
  else
    Serial.println(F("Done"));
}

/*
  Name  : CRC-8
  Poly  : 0x31    x^8 + x^5 + x^4 + 1
  Init  : 0xFF
  Revert: false
  XorOut: 0x00
  Check : 0xF7 ("123456789")
  MaxLen: 15 байт (127 бит) - обнаружение
    одинарных, двойных, тройных и всех нечетных ошибок
*/

const unsigned char Crc8Table[256] = {
    0x00, 0x31, 0x62, 0x53, 0xC4, 0xF5, 0xA6, 0x97,
    0xB9, 0x88, 0xDB, 0xEA, 0x7D, 0x4C, 0x1F, 0x2E,
    0x43, 0x72, 0x21, 0x10, 0x87, 0xB6, 0xE5, 0xD4,
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    0x3B, 0x0A, 0x59, 0x68, 0xFF, 0xCE, 0x9D, 0xAC
};

unsigned char CRC8(unsigned char *pcBlock, unsigned char len)
{
    unsigned char crc = 0xFF;

    while (len--)
        crc = Crc8Table[crc ^ *pcBlock++];

    return crc;
}